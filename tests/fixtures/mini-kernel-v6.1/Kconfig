## tests/fixtures/mini-kernel-v6.1/Kconfig
```kconfig
# SPDX-License-Identifier: GPL-2.0
#
# Mini kernel configuration for testing
#

config DEBUG_KERNEL
	bool "Kernel debugging"
	help
	  Enable kernel debugging features for development.

config VFS
	bool "Virtual File System support"
	default y
	help
	  Enable VFS layer for file operations.

config PROC_FS
	bool "Proc filesystem support"
	depends on VFS
	help
	  Enable /proc filesystem.

config 64BIT
	bool "64-bit kernel"
	default y
	help
	  Build for 64-bit architecture.

config X86_64
	bool "x86-64 support"
	depends on 64BIT
	help
	  Support for x86-64 architecture.

config PPC64LE
    bool "ppc64le support"
    depends on 64BIT
    help
      Support for ppc64le architecture.

config S390X
    bool "s390x support"
    depends on 64BIT
    help
      Support for s390x architecture.

source "arch/ppc64le/Kconfig"
source "arch/s390x/Kconfig"
source "rust/Kconfig"

config MODULES
	bool "Enable loadable module support"
	help
	  Enable support for loadable kernel modules.
```

## tests/fixtures/mini-kernel-v6.1/arch/ppc64le/Kconfig
```kconfig
#
# This is a generated file for testing purposes.
# Kconfig for ppc64le
#
config PPC64LE_EXAMPLE
    bool "ppc64le example support"
    default y
    help
      This is an example Kconfig entry for the ppc64le architecture.
```

## tests/fixtures/mini-kernel-v6.1/arch/s390x/Kconfig
```kconfig
#
# This is a generated file for testing purposes.
# Kconfig for s390x
#
config S390X_EXAMPLE
    bool "s390x example support"
    default y
    help
      This is an example Kconfig entry for the s390x architecture.
```

## tests/fixtures/mini-kernel-v6.1/rust/Kconfig
```kconfig
#
# This is a generated file for testing purposes.
# Kconfig for Rust example
#
config RUST_EXAMPLE
    tristate "Rust example module"
    default m
    help
      This is an example Kconfig entry for a Rust kernel module.
```
